## CMakeLists.txt
```
# SPDX-License-Identifier: Apache-2.0
# tests/zephyr/CMakeLists.txt — Zephyr ztest application for MicrOSAL
#
# Build with `west build` or `twister`:
#
#   west build -b native_sim tests/zephyr -- -DEXTRA_ZEPHYR_MODULES=/path/to/micrOSAL
#   west twister -T tests/zephyr
#
cmake_minimum_required(VERSION 3.20.0)

list(APPEND EXTRA_ZEPHYR_MODULES ${CMAKE_CURRENT_LIST_DIR}/../..)

# Merge the C++20 dialect choice after prj.conf so Zephyr's Kconfig choice is
# preserved in the generated .config.
list(APPEND EXTRA_CONF_FILE ${CMAKE_CURRENT_LIST_DIR}/cpp20.conf)

find_package(Zephyr REQUIRED HINTS $ENV{ZEPHYR_BASE})
project(microsal_ztest LANGUAGES CXX)

target_sources(app PRIVATE
    src/main.cpp
    src/portable_features.cpp
)

# MicrOSAL public headers
target_include_directories(app PRIVATE
    ${CMAKE_CURRENT_SOURCE_DIR}/../../include
)

# The module library gets OSAL_BACKEND_ZEPHYR via zephyr_library_compile_definitions(),
# but the app target needs it too so the public headers resolve active_traits.
target_compile_definitions(app PRIVATE OSAL_BACKEND_ZEPHYR)

# Zephyr selects the C++ dialect from Kconfig via cpp20.conf; only keep the
# embedded-facing ABI constraints here.
if(CMAKE_CXX_COMPILER_ID MATCHES "GNU|Clang")
    target_compile_options(app PRIVATE -fno-exceptions -fno-rtti)
endif()
```

## prj.conf
```kconfig
# SPDX-License-Identifier: Apache-2.0
# Zephyr project configuration for MicrOSAL ztest application
#
# This prj.conf enables the kernel features that the MicrOSAL Zephyr
# backend requires.  Users can overlay board-specific options via
# boards/<board>.conf or extra_conf_file.

# --- MicrOSAL module ---------------------------------------------------------
CONFIG_MICRO_OSAL=y

# --- C++ support --------------------------------------------------------------
CONFIG_CPP=y
CONFIG_REQUIRES_FULL_LIBCPP=y

# --- Kernel features required by the OSAL ------------------------------------
CONFIG_MAIN_STACK_SIZE=4096
CONFIG_SYSTEM_WORKQUEUE_STACK_SIZE=2048
CONFIG_HEAP_MEM_POOL_SIZE=8192

# Threading
CONFIG_MULTITHREADING=y
CONFIG_NUM_PREEMPT_PRIORITIES=16
CONFIG_SCHED_MULTIQ=y
CONFIG_INIT_STACKS=y
CONFIG_THREAD_STACK_INFO=y
CONFIG_THREAD_MONITOR=y
CONFIG_THREAD_NAME=y

# Native k_event objects for event flags (Zephyr 4.x)
CONFIG_EVENTS=y

# Timers

# Queues / message queues
CONFIG_POLL=y

# --- ztest framework ----------------------------------------------------------
CONFIG_ZTEST=y

# Stack size for the ztest thread
CONFIG_ZTEST_STACK_SIZE=8192

# Give tests time — QEMU can be slow
CONFIG_TEST_EXTRA_STACK_SIZE=2048
```

## cpp20.conf
```kconfig
# SPDX-License-Identifier: Apache-2.0

# Keep the C++ standard selection in a later-merged fragment. In this Zephyr
# tree, the choice assignment is dropped when placed directly in prj.conf.
CONFIG_STD_CPP20=y
```

## src/portable_features.cpp
```c
// SPDX-License-Identifier: Apache-2.0
#include <zephyr/ztest.h>
#include <zephyr/kernel.h>

#include "../../portable_feature_checks.hpp"

namespace
{
K_THREAD_STACK_DEFINE(wake_stack, 4096);

void check_feature(bool condition, const char* description)
{
    zexpect_true(condition, "%s", description);
}
}  // namespace

ZTEST(osal_portable_features, test_owned_zero_copy_loans)
{
    osal_test::verify_owned_loans(check_feature);
}

ZTEST(osal_portable_features, test_typed_topic_routing)
{
    osal_test::verify_typed_routing(check_feature);
}

ZTEST(osal_portable_features, test_checked_cancellation_lifecycle)
{
    osal_test::verify_checked_cancellation(check_feature);
}

ZTEST(osal_portable_features, test_event_driven_readiness)
{
    osal_test::verify_task_wakeup(check_feature, false, wake_stack, K_THREAD_STACK_SIZEOF(wake_stack));
}

ZTEST(osal_portable_features, test_event_driven_cancellation)
{
    osal_test::verify_task_wakeup(check_feature, true, wake_stack, K_THREAD_STACK_SIZEOF(wake_stack));
}

ZTEST(osal_portable_features, test_mutex_policy_and_diagnostics)
{
    osal_test::verify_policy_and_diagnostics(check_feature);
}

ZTEST(osal_portable_features, test_multi_object_waiting)
{
    osal_test::verify_object_waiting(check_feature);
}

ZTEST_SUITE(osal_portable_features, nullptr, nullptr, nullptr, nullptr, nullptr);
```
