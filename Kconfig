## Kconfig
```kconfig
# SPDX-License-Identifier: Apache-2.0
# Kconfig — MicrOSAL Zephyr module configuration

config MICRO_OSAL
	bool "MicrOSAL — Zephyr backend"
	default n
	help
	  Enables the Micro Operating System Abstraction Layer compiled
	  against the Zephyr RTOS backend.  Only one backend can be active
	  per build.

if MICRO_OSAL

choice MICRO_OSAL_BACKEND
	prompt "OSAL backend selection"
	default MICRO_OSAL_BACKEND_ZEPHYR
	help
	  Selects the underlying RTOS backend used by the OSAL.

config MICRO_OSAL_BACKEND_ZEPHYR
	bool "Zephyr"
	help
	  Use the Zephyr RTOS backend.  k_thread, k_mutex, k_sem,
	  k_msgq, k_timer, and k_condvar are used.

config MICRO_OSAL_BACKEND_BAREMETAL
	bool "Bare-metal (cooperative)"
	help
	  Use the software-only bare-metal backend.  No RTOS headers
	  are required.  Cooperative multitasking via setjmp/longjmp.

endchoice

config MICRO_OSAL_STACK_SIZE_DEFAULT
	int "Default thread stack size (bytes)"
	default 2048
	help
	  Default stack allocation when the application does not provide
	  an explicit stack for a thread.

choice MICRO_OSAL_TICK_WIDTH
	prompt "OSAL tick type width"
	default MICRO_OSAL_TICK_WIDTH_32
	help
	  Selects the width of osal::tick_t / osal_tick_t used at the
	  OSAL API boundary.

config MICRO_OSAL_TICK_WIDTH_32
	bool "32-bit tick type (uint32_t)"
	help
	  Uses a 32-bit timeout token. This is ABI-compact and sufficient
	  for most embedded systems.

config MICRO_OSAL_TICK_WIDTH_64
	bool "64-bit tick type (uint64_t)"
	help
	  Uses a 64-bit timeout token. Useful when very large finite
	  timeouts must be represented directly at the OSAL API boundary.

endchoice

config MICRO_OSAL_STRICT_TICK_INFERENCE
	bool "Strict tick compatibility checks"
	default n
	help
	  Enables strict tick compatibility behavior in the build system.
	  Intended for CI/release builds where ambiguous tick-width inference
	  should be treated as an error rather than a warning.

config MICRO_OSAL_WAIT_SET_MAX_ENTRIES
	int "Maximum number of entries in a wait_set"
	default 16
	range 1 64
	help
	  Sets the compile-time limit on how many file descriptors or
	  kernel objects can be tracked in a single wait_set instance.

config MICRO_OSAL_TIMER_MAX
	int "Maximum number of concurrent software timers"
	default 8
	range 1 64
	help
	  Maximum number of simultaneously live osal::timer instances.

config MICRO_OSAL_THREAD_MAX
	int "Maximum number of concurrent threads"
	default 8
	range 1 64
	help
	  Maximum number of simultaneously live osal::thread instances.

config MICRO_OSAL_MUTEX_MAX
	int "Maximum number of concurrent mutexes"
	default 16
	range 1 64
	help
	  Maximum number of simultaneously live osal::mutex instances backed by
	  native Zephyr k_mutex objects.

config MICRO_OSAL_SEMAPHORE_MAX
	int "Maximum number of concurrent semaphores"
	default 16
	range 1 64
	help
	  Maximum number of simultaneously live osal::semaphore instances backed by
	  native Zephyr k_sem objects.

config MICRO_OSAL_QUEUE_MAX
	int "Maximum number of concurrent queues"
	default 8
	range 1 32
	help
	  Maximum number of simultaneously live osal::queue instances backed by
	  native Zephyr k_msgq objects.

config MICRO_OSAL_EVENT_FLAGS_MAX
	int "Maximum number of concurrent event flag groups"
	default 8
	range 1 32
	help
	  Maximum number of simultaneously live osal::event_flags instances backed by
	  native Zephyr k_event objects.

config MICRO_OSAL_CONDVAR_MAX
	int "Maximum number of concurrent condition variables"
	default 16
	range 1 64
	help
	  Maximum number of simultaneously live osal::condvar instances backed by
	  native Zephyr k_condvar objects.

config MICRO_OSAL_WORK_QUEUE_MAX
	int "Maximum number of concurrent work queues"
	default 4
	range 1 16
	help
	  Maximum number of simultaneously live osal::work_queue instances backed by
	  native Zephyr k_work_q objects.

config MICRO_OSAL_WORK_QUEUE_DEPTH
	int "Maximum queued work items per work queue"
	default 32
	range 1 128
	help
	  Compile-time entry capacity for each native Zephyr osal::work_queue.

endif # MICRO_OSAL
```

## tests/nuttx/Kconfig
```kconfig
# SPDX-License-Identifier: Apache-2.0
# tests/nuttx/Kconfig
#
# Kconfig stanza for the MicrOSAL NuttX test application.
# Consumed by the NuttX build system when this directory is placed under
# nuttx-apps/testing/microsal_test.

config TESTING_MICROSAL_TEST
    tristate "MicrOSAL OSAL primitive tests"
    default n
    select LIBC_STRTOD
    select CPLUSPLUS
    select HAVE_CXX
    depends on !DISABLE_PTHREAD
    ---help---
        Builds the MicrOSAL doctest suite against the NuttX backend.
        The test application is registered as the built-in command
        "microsal_test".  Run it from the NuttX shell (NSH) or configure
        it as the init task (CONFIG_INIT_ENTRYPOINT="microsal_test_main").

        Enable this option in CI with sim/nsh to exercise the full NuttX
        OSAL backend on a hosted (Linux) simulation.

if TESTING_MICROSAL_TEST

config TESTING_MICROSAL_TEST_STACKSIZE
    int "Stack size for the MicrOSAL test task"
    default 65536
    ---help---
        Stack size in bytes for the test runner task.  The doctest framework
        uses significant stack for test result bookkeeping; 64 KiB is the
        recommended minimum.

config TESTING_MICROSAL_TEST_PRIORITY
    int "Priority of the MicrOSAL test task"
    default 100
    ---help---
        NuttX scheduling priority (higher = higher priority).
        100 is mid-range on the default SCHED_PRIORITY_DEFAULT scale.

endif # TESTING_MICROSAL_TEST
```

## tests/zephyr/testcase.yaml
```yaml
# SPDX-License-Identifier: Apache-2.0
# testcase.yaml — twister test descriptor for MicrOSAL Zephyr tests
#
# Run with:
#   west twister -T tests/zephyr
#   west twister -T tests/zephyr -p native_sim -p qemu_cortex_m3
#
# Users can retarget to any Zephyr-supported board/SoC by adding the
# board name to the platform_allow list or passing -p <board> to twister.

common:
  tags: osal rtos abstraction
  timeout: 120
  min_ram: 32
  min_flash: 128

tests:
  # -------------------------------------------------------------------
  # native_sim — runs as a native Linux process, fastest CI turnaround
  # -------------------------------------------------------------------
  microsal.ztest.native_sim:
    platform_allow:
      - native_sim
    integration_platforms:
      - native_sim

  # -------------------------------------------------------------------
  # nRF52840-DK via Renode — full SoC simulation (Cortex-M4F)
  #
  # Replaces the former qemu_cortex_m3 entry.  Renode simulates the
  # complete nRF52840 peripheral model (UART, clock, radio scheduler)
  # unlike bare QEMU which only emulates the CPU core.  This surfaces
  # hardware-timing issues that native_sim cannot catch.
  #
  # Run locally (with Renode in PATH):
  #   west twister -T tests/zephyr -p nrf52840dk/nrf52840 --runner renode
  # -------------------------------------------------------------------
  microsal.ztest.renode_nrf52840:
    platform_allow:
      - nrf52840dk/nrf52840
    integration_platforms:
      - nrf52840dk/nrf52840
    extra_configs:
      - CONFIG_SERIAL=y
      - CONFIG_UART_CONSOLE=y

  # -------------------------------------------------------------------
  # Generic — any board the user selects via `twister -p <board>`
  # Includes both QEMU and Renode-supported targets.
  # -------------------------------------------------------------------
  microsal.ztest:
    platform_allow:
      - native_sim
      - nrf52840dk/nrf52840
      - qemu_cortex_m3
      - qemu_cortex_m0
      - qemu_cortex_a53
      - qemu_riscv32
      - qemu_riscv64
      - stm32f4_disco
      - nucleo_f401re
```
